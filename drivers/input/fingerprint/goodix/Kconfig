## drivers/input/fingerprint/goodix/Kconfig
```kconfig
config FINGERPRINT_GOODIX_GF3118M
	tristate "Goodix GF3118M fingerprint driver (ZTE Axon 7)"
	depends on INPUT_FINGERPRINT
	help
	  GPIO/IRQ/power control and the /dev/goodix_fp interface for the
	  Goodix GF3118M sensor; the sensor itself is read by the TEE
	  (from the ZTE 3.18 kernel).
```

## drivers/platform/zte/Kconfig
```kconfig
# ZTE configuration options

config MACH_ZTE
	bool
	depends on ARCH_QCOM
	help
	  Support for ZTE products

menu "ZTE board selection"

config MACH_ZTE_AXON7
	bool "ZTE Axon 7 (ailsa_ii)"
	depends on ARCH_MSM8996
	select MACH_ZTE
	help
	  Support for the ZTE Axon 7 (A2017, A2017G, A2017U; codename
	  ailsa_ii). Builds only the Axon 7 device tree.

endmenu
```

## drivers/usb/typec/Kconfig
```kconfig
#
# USB Type-C controller drivers from the ZTE Axon 7 3.18 kernel
#

menuconfig USB_TYPEC
	bool "USB Type-C CC/mux controllers (ZTE Axon 7)"
	depends on I2C
	help
	  Drivers for the I2C USB Type-C configuration channel and mux
	  controllers fitted to the ZTE Axon 7. They set up the controller
	  at boot and export its state under /sys/class/type-c/chip.

if USB_TYPEC

config USB_PI5USB302
	bool "Pericom PI5USB302 Type-C controller"
	help
	  Say Y here if you have a Pericom PI5USB302 Type-C
	  controller (its chip info reads Pi5usb30213), as fitted to some
	  ZTE Axon 7 boards.

endif
```
